## config/west.yml
```yaml
manifest:
  defaults:
    revision: v0.3
  remotes:
    - name: zmkfirmware
      url-base: https://github.com/zmkfirmware
    - name: Good-Great-Grand-Wonderful
      url-base: https://github.com/Good-Great-Grand-Wonderful
    - name: SomalianIvan
      url-base: https://github.com/SomalianIvan
  projects:
    - name: zmk
      remote: zmkfirmware
      import: app/west.yml
    - name: gggw-zmk-keebs
      remote: SomalianIvan
      revision: main
      import: config/west.yml
  self:
    path: config
```
